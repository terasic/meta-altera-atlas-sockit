## conf/machine/atlas_sockit.conf
```bitbake
#@TYPE: Machine
#@NAME: atlas_sockit
#@DESCRIPTION: Machine configuration for the Cyclone V Atlas/DE0 SoCKit"

require conf/machine/include/socfpga.inc

PREFERRED_PROVIDER_virtual/kernel = "linux-altera"

PREFERRED_VERSION_u-boot-socfpga = "2013.01.01"

UBOOT_MACHINE = "socfpga_cyclone5"

KMACHINE = "atlas_sockit"

KERNEL_DEVICETREE = "socfpga_cyclone5_de0_sockit.dtb"
```
